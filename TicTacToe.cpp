/*
 * Project: TicTacToe for Educational Purposes
 * Author: Tino J. Strasser
 * Date: January 22, 2026
 *
 * Description:
 * Implementation of the TicTacToe class. Handles game logic, AI (Minimax),
 * idle animations, and hardware interaction management.
 *
 * Comments generated by: AI Gemini
 */

#include "TicTacToe.h"
#include <FastLED.h>
#include <stdlib.h>

/* -------------------------------------------------------------------------- */
/* CONFIGURATION CONSTANTS                                                    */
/* -------------------------------------------------------------------------- */
#define IDLE_TIMEOUT_MS 60000        /* Time before entering idle/demo mode */
#define IDLE_MOVE_INTERVAL_MS 2000    /* Speed of moves in demo mode */
#define COMPUTER_MOVE_DELAY_MS 1000   /* Artificial delay for AI thinking */
#define DEFAULT_GAME_MODE 1           /* 1 = Computer Opponent (default) */
#define MINIMAX_ALPHABETA_OFF 0       /* 0 = Smart AI (Minimax), 1 = Random Moves */
#define IDLE_COMPUTER_ERROR_RATE 30   /* Higher error rate for demo mode variance */

static int lastModeSwitchState = -1;

/* Infinity value for Minimax algorithm */
const int INFINITY_VAL = 10000;

/* Predefined game sequences for idle/demo mode */
const int PREDEFINED_GAMES[10][9] = {
    {0, 3, 1, 4, 2, -1, -1, -1, -1}, 
    {3, 0, 4, 1, 5, -1, -1, -1, -1}, 
    {6, 0, 7, 1, 8, -1, -1, -1, -1}, 
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    {4, 0, 1, 2, 7, 6, 3, 5, 8}      
};

/* Winning combinations (indices of lines) */
const int TicTacToe::_winLines[8][3] = {
    {0, 1, 2}, {3, 4, 5}, {6, 7, 8}, /* Horizontal */
    {0, 3, 6}, {1, 4, 7}, {2, 5, 8}, /* Vertical */
    {0, 4, 8}, {2, 4, 6}             /* Diagonal */
};

/* -------------------------------------------------------------------------- */
/* CLASS IMPLEMENTATION                                                    */
/* -------------------------------------------------------------------------- */

TicTacToe::TicTacToe() {
    onVictory = nullptr;
    onDraw = nullptr;
    onReset = nullptr;
    onResetPlayer = nullptr;
    onChangePlayer = nullptr;
    onCheckButtons = nullptr;

    _currentMode = COMPUTER;
    _lastMode = COMPUTER;

    for(int i=0; i<9; i++) _fieldTaken[i] = false;

    _leds = nullptr;
    _statusLed = nullptr;
    _currentPlayer = true;
    _lastButtonPressTime = 0;
    _isIdle = false;
    _idleMoveTimer = 0;
    _idleGameIndex = 0;
    _idleMoveIndex = 0;
    _computerErrorRate = 0;

    externalPlayer = nullptr;
    externalPlayerChanged = nullptr;
    externalPressedButton = nullptr;
    externalSetupDone = nullptr;
}

/*
 * Initializes hardware pins and links external state variables.
 */
void TicTacToe::begin(
    int buttonPins[9],
    int resetPin,
    int modeSwitchPin,
    int potPin,
    CRGB* leds,
    CRGB* statusLed,
    bool* player,
    bool* playerChanged,
    int* pressedButton,
    bool* setupDone
) {
    for (int i = 0; i < 9; i++) {
        _buttonPins[i] = buttonPins[i];
        pinMode(_buttonPins[i], INPUT_PULLUP);
        _fieldTaken[i] = false;
        _lastButtonState[i] = digitalRead(_buttonPins[i]);
    }

    _resetPin = resetPin;
    _modeSwitchPin = modeSwitchPin;
    _potPin = potPin;
    _leds = leds;
    _statusLed = statusLed;

    pinMode(_resetPin, INPUT_PULLUP);
    pinMode(_modeSwitchPin, INPUT_PULLUP);
    // Note: Analog pins (A0) do not need pinMode INPUT in standard Arduino
    
    lastModeSwitchState = digitalRead(_modeSwitchPin);

    _currentPlayer = true;
    
    externalPlayer = player;
    externalPlayerChanged = playerChanged;
    externalPressedButton = pressedButton;
    externalSetupDone = setupDone;

    _lastButtonPressTime = millis();
    _isIdle = false;

    /* Initial state check */
    handleModeSwitch();
}

/*
 * Main update loop. Handles mode switching, resets, timeouts, status LED and AI moves.
 */
void TicTacToe::update() {
    /* Read Potentiometer for Error Rate (0-100) */
    int potValue = analogRead(_potPin);
    _computerErrorRate = map(potValue, 0, 1023, 0, 100);

    handleModeSwitch();
    handleReset();
    updateStatusLed();
    
    if (_isIdle) {
        updateIdle();
        handleButtons(); 
    } else {
        handleButtons();
        
        /* Trigger Computer Move if in AI mode and it's AI's turn */
        if (_currentMode == COMPUTER && !_currentPlayer) {
            if (millis() - _lastButtonPressTime >= COMPUTER_MOVE_DELAY_MS) {
                computerMove();
            }
        }
        
        /* Check for inactivity to trigger Idle mode */
        if (millis() - _lastButtonPressTime > IDLE_TIMEOUT_MS) {
            startIdleAnimation();
        }
    }
}

/*
 * Updates the Status LED on D5 based on game state.
 */
void TicTacToe::updateStatusLed() {
    if (_statusLed == nullptr) return;

    CRGB targetColor = CRGB::Black;

    if (_isIdle) {
        /* In Idle: LED shows the color of the current player */
        targetColor = _currentPlayer ? CRGB::Red : CRGB::Blue;
    } else {
        /* In Active Game */
        if (_currentMode == COMPUTER) {
            /* Against Computer: Green */
            targetColor = CRGB::Green;
        } else {
            /* Against Player (PvP): Yellow (Gelb) */
            targetColor = CRGB::Yellow;
        }
    }

    /* Only update if changed to avoid bus spamming */
    if (_statusLed[0] != targetColor) {
        _statusLed[0] = targetColor;
        FastLED.show();
    }
}

/*
 * Processes button input from the external handler.
 */
void TicTacToe::handleButtons() {
    if (onCheckButtons) {
        onCheckButtons();
    }

    if (*externalPressedButton != -1) {
        /* If a button is pressed during idle, wake up */
        if (_isIdle) {
            stopIdle();
            *externalPressedButton = -1;
            return;
        }

        _lastButtonPressTime = millis();
        trySetField(*externalPressedButton);
        *externalPressedButton = -1;
    }
}

/*
 * Prepares the game for Idle/Demo mode.
 */
void TicTacToe::startIdleAnimation() {
    resetGame(); 
    _isIdle = true;
    _idleMoveTimer = millis();
    _currentPlayer = true; 

    /* Select a random game sequence if using predefined mode */
    if (DEFAULT_GAME_MODE == 0) {
        _idleGameIndex = random(0, 10);
        _idleMoveIndex = 0;
    }
}

/*
 * Executes moves automatically for the idle animation.
 */
void TicTacToe::updateIdle() {
    if (millis() - _idleMoveTimer < IDLE_MOVE_INTERVAL_MS) {
        return;
    }
    
    _idleMoveTimer = millis();

    if (DEFAULT_GAME_MODE == 1) {
        /* AI vs AI simulation */
        int move = getComputerMove(IDLE_COMPUTER_ERROR_RATE, !_currentPlayer);

        if (move == -1) {
            startIdleAnimation();
            return;
        }

        _fieldTaken[move] = true;
        _leds[move] = _currentPlayer ? CRGB::Red : CRGB::Blue;
        FastLED.show();

        int winLine;
        if (checkWin(_currentPlayer, winLine)) {
            if (onVictory) onVictory((int*)_winLines[winLine], _currentPlayer);
            if (onReset) onReset(); 
            startIdleAnimation();
            return;
        }

        if (checkDraw()) {
            if (onDraw) onDraw();
            if (onReset) onReset();
            startIdleAnimation();
            return;
        }

        _currentPlayer = !_currentPlayer;

    } else {
        /* Replay predefined games */
        int move = PREDEFINED_GAMES[_idleGameIndex][_idleMoveIndex];

        if (move == -1 || _idleMoveIndex >= 9) {
            startIdleAnimation();
            return;
        }

        _fieldTaken[move] = true;
        _leds[move] = _currentPlayer ? CRGB::Red : CRGB::Blue;
        FastLED.show();

        int winLine;
        if (checkWin(_currentPlayer, winLine)) {
            if (onVictory) onVictory((int*)_winLines[winLine], _currentPlayer);
            if (onReset) onReset(); 
            startIdleAnimation();
            return;
        }

        if (checkDraw()) {
            if (onDraw) onDraw();
            if (onReset) onReset();
            startIdleAnimation();
            return;
        }

        _currentPlayer = !_currentPlayer;
        _idleMoveIndex++;
    }
}

/*
 * Exits idle mode and returns to active gameplay.
 */
void TicTacToe::stopIdle() {
    _isIdle = false;
    resetGame();
    _lastButtonPressTime = millis();
}

/*
 * Attempts to place a marker on the field if the index is valid and empty.
 */
void TicTacToe::trySetField(int i) {
    if (_fieldTaken[i]) return;

    _fieldTaken[i] = true;
    _leds[i] = _currentPlayer ? CRGB::Red : CRGB::Blue;
    FastLED.show();

    int winLine;
    if (checkWin(_currentPlayer, winLine)) {
        if (onVictory) onVictory((int*)_winLines[winLine], _currentPlayer);
        resetGame();
        return;
    }

    if (checkDraw()) {
        if (onDraw) onDraw();
        resetGame();
        return;
    }

    changePlayerInternal();
}

/*
 * Handles player switching logic and external notification.
 */
void TicTacToe::changePlayerInternal() {
    if (onChangePlayer) onChangePlayer();

    if (externalPlayerChanged && *externalPlayerChanged) {
        _currentPlayer = *externalPlayer;
        *externalPlayerChanged = false;
    }
}

/*
 * Checks if the specified player has won.
 * Writes the index of the winning line to winLineIndex.
 */
bool TicTacToe::checkWin(bool player, int& winLineIndex) {
    CRGB color = player ? CRGB::Red : CRGB::Blue;

    for (int i = 0; i < 8; i++) {
        int a = _winLines[i][0];
        int b = _winLines[i][1];
        int c = _winLines[i][2];

        if (_fieldTaken[a] && _fieldTaken[b] && _fieldTaken[c] &&
            _leds[a] == color &&
            _leds[b] == color &&
            _leds[c] == color) {
            winLineIndex = i;
            return true;
        }
    }
    return false;
}

/*
 * Checks if the board is full (Draw condition).
 */
bool TicTacToe::checkDraw() {
    for (int i = 0; i < 9; i++) {
        if (!_fieldTaken[i]) return false;
    }
    return true;
}

/*
 * Resets the game board and state variables.
 */
void TicTacToe::resetGame() {
    for (int i = 0; i < 9; i++) {
        _fieldTaken[i] = false;
        _leds[i] = CRGB::Black;
    }
    FastLED.show();
    
    if (onResetPlayer) onResetPlayer();

    if (externalPlayer) {
        _currentPlayer = *externalPlayer;
    }
    
    /* Ensure Status LED is correct immediately after reset */
    updateStatusLed();

    if (onReset && !_isIdle) onReset();
}

/*
 * Getter for button debounce logic.
 */
bool TicTacToe::getLastButtonState(int i) {
    return _lastButtonState[i];
}

/*
 * Setter for button debounce logic.
 */
void TicTacToe::setLastButtonState(int i, bool state) {
    _lastButtonState[i] = state;
}

/*
 * Monitors the physical reset button (Active LOW).
 * Uses A2 as defined in setup.
 */
void TicTacToe::handleReset() {
    static unsigned long resetStartTime = 0;

    if (digitalRead(_resetPin) == LOW) {
        /* Reset pressed: Blink Status LED Red/Blue while holding */
        /* Task: "Während einem Reset soll es wieder abwechselnd blau und rot leuchten" */
        if (_statusLed != nullptr) {
             _statusLed[0] = (millis() / 200 % 2) ? CRGB::Red : CRGB::Blue;
             FastLED.show();
        }

        if (resetStartTime == 0) {
            resetStartTime = millis();
        } else if (millis() - resetStartTime > 2000) {
            if (_isIdle) {
                stopIdle();
            } else {
                resetGame();
            }
        }
    } else {
        if (resetStartTime != 0) {
            /* Button released, restore correct status color */
            resetStartTime = 0;
            updateStatusLed(); 
        }
    }
}

/*
 * Monitors the mode switch toggle.
 * LOW = Default Mode (Computer), HIGH = Other (PvP).
 */
void TicTacToe::handleModeSwitch() {
    int modeSwitchState = digitalRead(_modeSwitchPin);

    /* If state changed, reset game */
    if (modeSwitchState != lastModeSwitchState) {
        if (_isIdle) {
            stopIdle();
        }
        
        if (modeSwitchState == LOW) {
            /* Low = Default = Computer */
            _currentMode = COMPUTER;
        } else {
            /* High = PvP */
            _currentMode = TWO_PLAYER;
        }
        resetGame();
        lastModeSwitchState = modeSwitchState;
    }
}

/*
 * Initiates the AI move calculation.
 */
void TicTacToe::computerMove() {
    /* Use the dynamic error rate from potentiometer */
    int move = getComputerMove(_computerErrorRate, true);
    if (move != -1) {
        trySetField(move);
    }
}

/* -------------------------------------------------------------------------- */
/* AI / MINIMAX LOGIC                                                       */
/* -------------------------------------------------------------------------- */

/* * Helper: Fast win check on a virtual board.
 * Returns: 1 (AI wins), -1 (Opponent wins), 0 (No winner yet)
 */
int TicTacToe::checkWinFast(const int8_t* board) {
    /* Horizontal checks */
    if (board[0] != 0 && board[0] == board[1] && board[1] == board[2]) return board[0];
    if (board[3] != 0 && board[3] == board[4] && board[4] == board[5]) return board[3];
    if (board[6] != 0 && board[6] == board[7] && board[7] == board[8]) return board[6];
    
    /* Vertical checks */
    if (board[0] != 0 && board[0] == board[3] && board[3] == board[6]) return board[0];
    if (board[1] != 0 && board[1] == board[4] && board[4] == board[7]) return board[1];
    if (board[2] != 0 && board[2] == board[5] && board[5] == board[8]) return board[2];
    
    /* Diagonal checks */
    if (board[0] != 0 && board[0] == board[4] && board[4] == board[8]) return board[0];
    if (board[2] != 0 && board[2] == board[4] && board[4] == board[6]) return board[2];
    
    return 0;
}

/*
 * Determines the best move for the computer.
 * Uses Minimax algorithm unless disabled or error rate triggers a random move.
 */
int TicTacToe::getComputerMove(int errorRate, bool playerIsBlue) {
    /* If Smart AI is disabled, return a random valid move */
    if (MINIMAX_ALPHABETA_OFF == 1) {
        int availableMoves[9];
        int count = 0;
        for (int i = 0; i < 9; i++) {
            if (!_fieldTaken[i]) {
                availableMoves[count++] = i;
            }
        }
        
        if (count > 0) {
            return availableMoves[random(count)];
        }
        return -1;
    }

    /* Determine if the AI should intentionally make a mistake */
    bool forceBadMove = (random(100) < errorRate);
    
    /* * Create a virtual board for recursion (RAM optimized).
     * 0 = Empty, 1 = AI (Maximizing), -1 = Opponent (Minimizing)
     */
    int8_t virtualBoard[9];
    int availableMoves = 0;
    
    CRGB myColor = playerIsBlue ? CRGB::Blue : CRGB::Red;
    CRGB opColor = playerIsBlue ? CRGB::Red : CRGB::Blue; // Unused but kept for logic clarity
    
    for(int i=0; i<9; i++) {
        if (!_fieldTaken[i]) {
            virtualBoard[i] = 0;
            availableMoves++;
        } else {
            /* Map existing board state to virtual board */
            if (_leds[i] == myColor) {
                virtualBoard[i] = 1; 
            } else {
                virtualBoard[i] = -1;
            }
        }
    }

    /* * Optimization: If the center (index 4) is free, take it.
     * This is statistically the best opening/counter-opening and saves recursion depth.
     */
    if (!forceBadMove && virtualBoard[4] == 0) {
        return 4;
    }

    /* Handle forced error condition by picking a random available move */
    if (forceBadMove) {
        int r = random(availableMoves);
        int count = 0;
        for(int i=0; i<9; i++) {
            if(virtualBoard[i] == 0) {
                if(count == r) return i;
                count++;
            }
        }
    }

    /* Start Minimax with Alpha-Beta Pruning */
    int bestVal = -INFINITY_VAL;
    int bestMove = -1;
    
    /* Iterate through root nodes manually to track the best move index */
    for (int i = 0; i < 9; i++) {
        if (virtualBoard[i] == 0) {
            virtualBoard[i] = 1; /* AI tentatively makes move */
            
            /* * Call recursive minimax.
             * Alpha initialized to -Infinity, Beta to +Infinity.
             */
            int moveVal = minimaxAlphaBeta(virtualBoard, 0, false, -INFINITY_VAL, INFINITY_VAL);
            
            virtualBoard[i] = 0; /* Backtrack (undo move) */

            if (moveVal > bestVal) {
                bestMove = i;
                bestVal = moveVal;
            }
        }
    }
    
    return bestMove;
}

/*
 * Recursive Minimax algorithm with Alpha-Beta Pruning.
 * Determines the score of a board state.
 */
int TicTacToe::minimaxAlphaBeta(int8_t* board, int depth, bool isMaximizing, int alpha, int beta) {
    /* Check terminal states */
    int score = checkWinFast(board);
    
    /* Prefer faster victories (subtract depth) and slower defeats */
    if (score == 1) return 10 - depth;  
    if (score == -1) return depth - 10; 
    
    /* Check for Draw (Board Full) */
    bool full = true;
    for(int i=0; i<9; i++) {
        if(board[i] == 0) {
            full = false; 
            break;
        }
    }
    if (full) return 0;

    if (isMaximizing) {
        int best = -INFINITY_VAL;
        for (int i = 0; i < 9; i++) {
            if (board[i] == 0) {
                board[i] = 1;
                /* Recursively call for minimizing player */
                int val = minimaxAlphaBeta(board, depth + 1, false, alpha, beta);
                board[i] = 0;
                
                best = max(best, val);
                alpha = max(alpha, best);
                
                /* Beta Cutoff */
                if (beta <= alpha) break; 
            }
        }
        return best;
    } else {
        int best = INFINITY_VAL;
        for (int i = 0; i < 9; i++) {
            if (board[i] == 0) {
                board[i] = -1;
                /* Recursively call for maximizing player */
                int val = minimaxAlphaBeta(board, depth + 1, true, alpha, beta);
                board[i] = 0;
                
                best = min(best, val);
                beta = min(beta, best);
                
                /* Alpha Cutoff */
                if (beta <= alpha) break;
            }
        }
        return best;
    }
}