/*
 * Project: TicTacToe for Educational Purposes
 * Author: Tino J. Strasser
 * Date: January 22, 2026
 *
 * Description:
 * Main sketch for the educational TicTacToe project using FastLED.
 * This file serves as the solution template.
 *
 * Comments generated by: AI Gemini
 */

#include "TicTacToe.h"
#include <FastLED.h>

/* -------------------------------------------------------------------------- */
/* 1. CONFIGURATION & VARIABLES (GLOBALS)                                     */
/* -------------------------------------------------------------------------- */

/* LED Configuration */
#define STRIP_PIN     6
#define STATUS_LED_PIN 5     /* Status LED Pin */
#define NUM_LEDS      9
#define BRIGHTNESS    150
#define LED_TYPE      WS2812B
#define COLOR_ORDER   GRB

CRGB leds[NUM_LEDS];
CRGB statusLed[1];           /* Array for the single status LED */

/* Button Configuration */
/* Mapping order: C1, C2, C3, B1, B2, B3, A1, A2, A3 */
int buttonPins[9];

/* Control Pins */
#define POT_PIN       A0     /* Error Rate Control */
#define MODE_SWITCH_PIN A1   /* Game Mode Switch */
#define RESET_PIN     A2     /* Reset Button */

/* Game Objects & State */
TicTacToe game;
bool isSetupDone = false;

/* Student-accessible variables */
bool currentPlayer = true;    /* true = Player X, false = Player O */
bool playerChanged = false;   /* Flag: Turn change occurred */
int pressedButton = -1;       /* Index of pressed button (-1 = none) */

/* Forward declaration of internal helper */
void advancedSetup(); 

/* -------------------------------------------------------------------------- */
/* 2. MAIN ARDUINO FUNCTIONS (SETUP & LOOP)                                   */
/* -------------------------------------------------------------------------- */

void setup() {
  /* Initialize Hardware */
  fastLedSetup();
  setPins();

  /* Initialize Game Engine */
  game.begin(
    buttonPins,
    RESET_PIN,
    MODE_SWITCH_PIN,
    POT_PIN,          
    leds,
    statusLed,        
    &currentPlayer,
    &playerChanged,
    &pressedButton,
    &isSetupDone 
  );

  /* Link Callbacks to Student Functions */
  game.onVictory      = victoryAnimation;
  game.onDraw         = drawAnimation;
  game.onReset        = advancedSetup;
  game.onResetPlayer  = resetPlayer;
  game.onChangePlayer = changePlayer;
  game.onCheckButtons = checkButtons;

  /* Run Initial Setup */
  advancedSetup();
}

void loop() {
  game.update();
}

/* ========================================================================== */
/* ========================================================================== */
/* */
/* 3. STUDENT TASKS / AUFGABEN                                              */
/* Implement logic and hardware settings in this section.                   */
/* */
/* ========================================================================== */
/* ========================================================================== */

/*
 * Task 1: Hardware Abstraction
 * Map logical button indices (0-8) to physical microcontroller pins.
 */
void setPins() {
  /* Confirmed mapping: D2-D4, D7-D9, D10-D12 */
  int buttonValues[9] = {2, 3, 4, 7, 8, 9, 10, 11, 12};

  for (int i = 0; i < 9; i++) {
      buttonPins[i] = buttonValues[i]; 
  }
}

/*
 * Task 2: Library Initialization
 * Configure and initialize the FastLED library.
 */
void fastLedSetup() {
  /* Initialize Main Strip */
  FastLED.addLeds<LED_TYPE, STRIP_PIN, COLOR_ORDER>(leds, NUM_LEDS);
  
  /* Initialize Status LED */
  FastLED.addLeds<LED_TYPE, STATUS_LED_PIN, COLOR_ORDER>(statusLed, 1);

  FastLED.setBrightness(BRIGHTNESS);
  FastLED.clear();
  FastLED.show();
}

/*
 * Task 3: LED Control
 * Helper function to turn off a specific LED.
 */
void ledBlack(int i) {
  leds[i] = CRGB::Black;
}

/*
 * Task 4: Game Logic - Reset
 * Reset player state to default (Player X starts).
 * Reset setup flag to trigger intro animation again.
 */
void resetPlayer() {
  currentPlayer = true; 
}

/*
 * Task 5: Game Logic - Player Switch
 * Toggle the active player and set the change flag.
 */
void changePlayer() {
  currentPlayer = !currentPlayer; 
  playerChanged = true; 
}

/*
 * Task 6: Input Handling
 * Poll buttons and detect falling edges (press events).
 */
void checkButtons() {
  pressedButton = -1; 

  for (int i = 0; i < 9; i++) {
    bool currentState = digitalRead(buttonPins[i]);
    
    /* Detect falling edge (HIGH -> LOW transition) */
    if (game.getLastButtonState(i) == HIGH && currentState == LOW) {
      pressedButton = i; 
    }
    
    /* Store state for debounce/edge detection */
    game.setLastButtonState(i, currentState);
  }
}

/* ========================================================================== */
/* ========================================================================== */
/* */
/* 4. ANIMATIONS / ANIMATIONEN                                              */
/* Implement visual patterns and feedback here.                             */
/* */
/* ========================================================================== */
/* ========================================================================== */

/*
 * Intro Animation
 * Runs once when the game starts or resets.
 */
void advancedSetupAnimation() {
  const int pauseTime = 400; 

  /* Status LED blinking logic during setup */
  auto blinkStatus = [&](CRGB color) {
      statusLed[0] = color;
      FastLED.show();
  };

  /* Pattern 1: Red X (Status Red) */
  blinkStatus(CRGB::Red);
  leds[0] = CRGB::Red;   leds[1] = CRGB::Black; leds[2] = CRGB::Red;
  leds[3] = CRGB::Black; leds[4] = CRGB::Red;   leds[5] = CRGB::Black;
  leds[6] = CRGB::Red;   leds[7] = CRGB::Black; leds[8] = CRGB::Red;
  FastLED.show();
  delay(pauseTime);

  /* Pattern 2: Blue Circle (Status Blue) */
  blinkStatus(CRGB::Blue);
  leds[0] = CRGB::Blue;   leds[1] = CRGB::Blue;  leds[2] = CRGB::Blue;
  leds[3] = CRGB::Blue;   leds[4] = CRGB::Black; leds[5] = CRGB::Blue;
  leds[6] = CRGB::Blue;   leds[7] = CRGB::Blue;  leds[8] = CRGB::Blue;
  FastLED.show();
  delay(pauseTime);

  /* Pattern 3: Red X (Status Red) */
  blinkStatus(CRGB::Red);
  leds[0] = CRGB::Red;   leds[1] = CRGB::Black; leds[2] = CRGB::Red;
  leds[3] = CRGB::Black; leds[4] = CRGB::Red;   leds[5] = CRGB::Black;
  leds[6] = CRGB::Red;   leds[7] = CRGB::Black; leds[8] = CRGB::Red;
  FastLED.show();
  delay(pauseTime);

  /* Pattern 4: Blue Circle (Status Blue) */
  blinkStatus(CRGB::Blue);
  leds[0] = CRGB::Blue;   leds[1] = CRGB::Blue;  leds[2] = CRGB::Blue;
  leds[3] = CRGB::Blue;   leds[4] = CRGB::Black; leds[5] = CRGB::Blue;
  leds[6] = CRGB::Blue;   leds[7] = CRGB::Blue;  leds[8] = CRGB::Blue;
  FastLED.show();
  delay(pauseTime);

  /* Clear */
  for (int i = 0; i < 9; i++) ledBlack(i);
  FastLED.show();

  /* Pattern 5: Checkerboard Fill */
  for (int i = 0; i < 9; i++) {
      leds[i] = i % 2 ? CRGB::Red : CRGB::Blue;
      /* Fast alternating status blink */
      statusLed[0] = (i % 2) ? CRGB::Red : CRGB::Blue;
      FastLED.show();
      delay(pauseTime/3);
  } 

  /* Final Clear */
  for (int i = 0; i < 9; i++) ledBlack(i);
  statusLed[0] = CRGB::Black; /* Reset status led */
  FastLED.show();
}

/*
 * Victory Animation
 * Blinks the winning line.
 */
void victoryAnimation(int winningLine[3], bool winnerIs) {
  CRGB winColor = winnerIs ? CRGB::Red : CRGB::Blue;

  for (int blink = 0; blink < 5; blink++) {
    /* Line ON */
    for (int i = 0; i < 3; i++) {
      leds[winningLine[i]] = winColor;
    }
    FastLED.show();
    delay(300);

    /* Line OFF */
    for (int i = 0; i < 3; i++) {
      leds[winningLine[i]] = CRGB::Black;
    }
    FastLED.show();
    delay(300);
  }
}

/*
 * Draw/Tie Animation
 * Blinks the entire board.
 */
void drawAnimation() {
  CRGB ledCurrentState[NUM_LEDS];

  /* Save State */
  for (int led = 0; led < NUM_LEDS; led++) {
      ledCurrentState[led] = leds[led];
  }

  for (int blink = 0; blink < 3; blink++) {
    /* All OFF */
    for (int i = 0; i < 9; i++) ledBlack(i);
    FastLED.show();
    delay(300);

    /* Restore */
    for (int i = 0; i < 9; i++) {
      leds[i] = ledCurrentState[i];
    }
    FastLED.show();
    delay(300);
  }

  /* Final Clear */
  for (int i = 0; i < 9; i++) ledBlack(i);
  FastLED.show();
}

/* -------------------------------------------------------------------------- */
/* 5. INTERNAL HELPERS (DO NOT EDIT)                                          */
/* -------------------------------------------------------------------------- */

/*
 * Wrapper for the setup animation to ensure it runs only when needed.
 */
void advancedSetup() {
  if (!isSetupDone) {
    advancedSetupAnimation();
    isSetupDone = true;  
  }

  for (int i = 0; i < 9; i++) {
    ledBlack(i);
  }
  FastLED.show();
}